## server_esp/components/esp_mqtt/Kconfig
```kconfig
menu "MQTT Component Configuration"

    # MQTT 组件配置项：
    # 这里保存阿里云 MQTT 连接参数、事件任务参数、Topic/Payload 长度和 TLS 开关。
    # 修改前要确认阿里云产品 ProductKey、DeviceName、ClientId、Username、Password 是否匹配。

    config MQTT_BROKER_HOST
        string "MQTT Broker Host"
        default "iot-06z00dgi0u8jci8.mqtt.iothub.aliyuncs.com"
        help
            阿里云 MQTT Broker 地址，ESP32 连接云端时使用。
            Hostname or IP address of the MQTT broker.
            Example: broker.example.com or 192.168.1.100

    config MQTT_BROKER_PORT
        int "MQTT Broker Port"
        default 1883
        range 1 65535
        help
            MQTT 端口号。当前默认 1883，表示普通 TCP MQTT。
            Port number of the MQTT broker.
            Default: 1883 for standard MQTT.

    config MQTT_CLIENT_ID
        string "MQTT Client ID"
        default "k1vtgAzED8C.7Rzu9Cy7Ze6Yhe1YcMjQ|securemode=2,signmethod=hmacsha256,timestamp=1781099957494|"
        help
            阿里云设备连接用 Client ID，必须和设备三元组及签名参数对应。
            Client identifier for MQTT connection.
            Must be unique per client connected to the broker.

    config MQTT_USERNAME
        string "MQTT Username"
        default "7Rzu9Cy7Ze6Yhe1YcMjQ&k1vtgAzED8C"
        help
            阿里云 MQTT 用户名，一般格式为 DeviceName&ProductKey。
            Username for MQTT broker authentication.
            Leave empty if no authentication required.

    config MQTT_PASSWORD
        string "MQTT Password"
        default "9d8a5497902d72cc11704e2df41983c445d4e25e8438fcb645f2725b330e0627"
        help
            阿里云 MQTT 密码/签名值，设备三元组或时间戳变化后需要重新生成。
            Password for MQTT broker authentication.
            Leave empty if no authentication required.

    config MQTT_KEEPALIVE_SEC
        int "MQTT Keep Alive (seconds)"
        default 60
        range 10 3600
        help
            MQTT 心跳保活时间，网络不稳定时可适当调整。
            MQTT keep alive interval in seconds.

    config ESP_MQTT_EVT_TASK_STACK_SIZE
        int "MQTT Event Task Stack Size"
        default 8192
        range 4096 32768
        help
            MQTT 事件任务栈大小，JSON 解析和日志较多时不能太小。
            Stack size for the MQTT event processing task.

    config ESP_MQTT_EVT_TASK_PRIORITY
        int "MQTT Event Task Priority"
        default 5
        range 1 24
        help
            MQTT 事件任务优先级，影响消息处理及时性。
            Priority of the MQTT event processing task.

    config MQTT_MAX_TOPIC_LEN
        int "Maximum Topic Length"
        default 128
        range 32 512
        help
            MQTT Topic 最大长度，阿里云自定义 Topic 较长时需要保证这里足够。
            Maximum length of MQTT topics.

    config MQTT_MAX_PAYLOAD_LEN
        int "Maximum Payload Length"
        default 4096
        range 512 16384
        help
            MQTT Payload 最大长度，衣柜命令 JSON 很短，状态或扩展消息可按需增大。
            Maximum length of MQTT payloads.

    config MQTT_RECONNECT_INTERVAL_MS
        int "Reconnect Interval (ms)"
        default 5000
        range 1000 60000
        help
            MQTT 断线重连间隔，单位 ms。
            Interval between reconnection attempts in milliseconds.

    config MQTT_ENABLE_SSL
        bool "Enable MQTT over SSL/TLS"
        default n
        help
            是否启用 TLS。当前默认关闭，启用后需要配置 Broker 证书。
            Enable secure MQTT connection using TLS/SSL.
            Requires broker certificate configuration.

    config MQTT_BROKER_CERT
        string "Broker Certificate (PEM format)"
        default ""
        depends on MQTT_ENABLE_SSL
        help
            TLS 模式下使用的 Broker PEM 证书。
            Broker certificate in PEM format for secure MQTT.
            Required for MQTT over SSL/TLS.

endmenu
```

## server_esp/components/uart/Kconfig
```kconfig
menu "UART Component Configuration"

    # UART 组件配置项：
    # 当前项目主要用 UART 把 ESP32 收到的云端衣柜命令转成 STM32 二进制帧。
    # ACK 功能只是通用串口调试回执，不等同于 STM32 衣柜协议响应。

    config UART_ENABLE_ACK
        bool "Enable UART acknowledgement on data reception"
        default n
        help
            是否在 UART 收到数据后自动回发 ACK。衣柜协议一般保持关闭，避免干扰 STM32 二进制帧。
            When enabled, the UART component will send an acknowledgement
            message back to the same UART port after receiving data.
            The acknowledgement message is "OK\\n".

    config UART_ACK_MESSAGE
        string "UART acknowledgement message"
        default "OK\\n"
        depends on UART_ENABLE_ACK
        help
            自动 ACK 文本内容。只有 UART_ENABLE_ACK 打开时才会使用。
            The message sent back to UART port after receiving data.
            Include newline characters as needed.

endmenu
```

## server_esp/components/wifi/Kconfig
```kconfig
menu "WiFi Component Configuration"

    # WiFi 组件配置项：
    # STA 模式用于连接路由器并访问阿里云 MQTT；AP 模式用于设备自己开热点。
    # 修改 SSID/密码后需要重新编译或通过 menuconfig 生成新的 sdkconfig。

    config WIFI_STA_SSID
        string "Station Mode SSID"
        default "Zqbkami"
        help
            ESP32 作为 STA 连接的路由器 WiFi 名称。
            SSID of the WiFi network to connect to in station mode.

    config WIFI_STA_PASSWORD
        string "Station Mode Password"
        default "2396487484"
        help
            ESP32 作为 STA 连接路由器时使用的 WiFi 密码。
            Password for the WiFi network in station mode.

    config WIFI_STA_SCAN_METHOD
        int "Station Scan Method"
        default 0
        range 0 1
        help
            STA 扫描方式：0 扫描全部信道，1 找到匹配 SSID 后快速停止。
            WiFi scan method for station mode.
            0: WIFI_ALL_CHANNEL_SCAN (scan all channels)
            1: WIFI_FAST_SCAN (stop on first matching SSID)

    config WIFI_STA_SORT_METHOD
        int "Station Sort Method"
        default 0
        range 0 1
        help
            多个同名 AP 时的选择方式：按信号强度或安全等级排序。
            Sort method for AP selection in station mode.
            0: WIFI_CONNECT_AP_BY_SIGNAL (by signal strength)
            1: WIFI_CONNECT_AP_BY_SECURITY (by security level)

    config WIFI_STA_RSSI_THRESHOLD
        int "Station RSSI Threshold (dBm)"
        default -127
        range -127 0
        help
            STA 连接时允许的最低 RSSI，-127 表示不限制信号强度。
            Minimum RSSI threshold for AP connection in station mode.
            -127 means accept any signal strength.

    config WIFI_AP_SSID
        string "Access Point SSID"
        default "ESP32_AP"
        help
            ESP32 作为 AP 热点时广播的 WiFi 名称。
            SSID for the ESP32 when operating in Access Point mode.

    config WIFI_AP_PASSWORD
        string "Access Point Password"
        default "12345678"
        help
            ESP32 AP 热点密码，WPA2-PSK 要求至少 8 个字符。
            Password for the ESP32 when operating in Access Point mode.
            Must be at least 8 characters for WPA2-PSK.

    config WIFI_AP_CHANNEL
        int "Access Point Channel"
        default 1
        range 1 13
        help
            ESP32 AP 热点信道。
            WiFi channel for Access Point mode.

    config WIFI_AP_MAX_CONN
        int "Access Point Maximum Connections"
        default 4
        range 1 10
        help
            AP 模式允许同时连接的最大客户端数量。
            Maximum number of simultaneous station connections
            in Access Point mode.

    config WIFI_AP_BEACON_INTERVAL
        int "Access Point Beacon Interval (ms)"
        default 100
        range 100 1000
        help
            AP 信标间隔，单位 ms。
            Beacon interval in milliseconds for Access Point mode.

    config WIFI_MAX_RETRY_COUNT
        int "Maximum Connection Retry Count"
        default 5
        range 1 20
        help
            STA 连接失败后的最大重试次数。
            Maximum number of reconnection attempts before giving up.

endmenu
```
